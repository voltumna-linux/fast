## conf/distro/fast.conf
```bitbake
require conf/distro/voltumna.conf

DISTRO_NAME = "FAST"
SDK_VENDOR = "-fastsdk"
TARGET_VENDOR = "-fast"

OLDEST_KERNEL = "6.18"
LINUXLIBCVERSION = "6.18"
PREFERRED_VERSION_virtual/kernel = "6.18%"
PREFERRED_VERSION_linux-libc-headers = "6.18%"
PREFERRED_VERSION_linux-intel = "${PREFERRED_VERSION_virtual/kernel}"
PREFERRED_VERSION_linux-amd = "6.18.33"

PREFERRED_VERSION_nativesdk-libgfortran = "${GCCVERSION}"

PREFERRED_VERSION_tango-idl = "6.0%"
PREFERRED_VERSION_nativesdk-tango-idl = "6.0%"
PREFERRED_VERSION_cpptango = "10.3.%"
PREFERRED_VERSION_nativesdk-cpptango = "10.3.%"
PREFERRED_VERSION_python3-pytango = "10.3.%"
PREFERRED_VERSION_starter = "9.1"
PREFERRED_VERSION_nativesdk-python3-pytango = "10.3.%"
PREFERRED_VERSION_nativesdk-pogo = "9.10%"

# Necessary to add lapack
FORTRAN:forcevariable = ",fortran"
RUNTIMETARGET:append:pn-gcc-runtime = " libquadmath"
HOSTTOOLS += "gfortran"
```
